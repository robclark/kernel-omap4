## Documentation/devicetree/bindings/drm/tilcdc/slave.txt
```
Device-Tree bindings for tilcdc DRM encoder slave output driver

Required properties:
 - compatible: value should be "tilcdc,slave".
 - i2c: the phandle for the i2c device the encoder slave is connected to

Recommended properties:
 - pinctrl-names, pinctrl-0: the pincontrol settings to configure
   muxing properly for pins that connect to TFP410 device

Example:

	hdmi {
		compatible = "tilcdc,slave";
		i2c = <&i2c0>;
		pinctrl-names = "default";
		pinctrl-0 = <&nxp_hdmi_bonelt_pins>;
	};
	
```

## Documentation/devicetree/bindings/uio/pruss.txt
```
TI PRUSS device

Required properties:
- compatible :
  - "ti,pruss-v1" for AM18xx/OMAP-L138/DA850
  - "ti,pruss-v2" for AM33xx.
- ti,pintc-offset : Offset of the PINTC from the PRUSS address base
- ti,hwmods: Name of the hwmod associated to the PRUSS

Example:

pruss: pruss@4a300000 {
	compatible = "ti,pruss-v2";
	ti,hwmods = "pruss";
	reg = <0x4a300000 0x080000>;
	ti,pintc-offset = <0x20000>;
};
```

## Documentation/devicetree/bindings/video/display-timings.txt
```
display-timings bindings
==================

display-timings-node
------------

required properties:
 - none

optional properties:
 - native-mode: the native mode for the display, in case multiple modes are
		provided. When omitted, assume the first node is the native.

timings-subnode
---------------

required properties:
 - hactive, vactive: Display resolution
 - hfront-porch, hback-porch, hsync-len: Horizontal Display timing parameters
   in pixels
   vfront-porch, vback-porch, vsync-len: Vertical display timing parameters in
   lines
 - clock-frequency: displayclock in Hz

optional properties:
 - hsync-active : Hsync pulse is active low/high/ignored
 - vsync-active : Vsync pulse is active low/high/ignored
 - de-active : Data-Enable pulse is active low/high/ignored
 - pixelclk-inverted : pixelclock is inverted/non-inverted/ignored
 - interlaced (bool)
 - doublescan (bool)

All the optional properties that are not bool follow the following logic:
    <1> : high active
    <0> : low active
    omitted : not used on hardware

There are different ways of describing the capabilities of a display. The devicetree
representation corresponds to the one commonly found in datasheets for displays.
If a display supports multiple signal timings, the native-mode can be specified.

The parameters are defined as

struct display_timing
===================

  +----------+---------------------------------------------+----------+-------+
  |          |                ?                            |          |       |
  |          |                |vback_porch                 |          |       |
  |          |                ?                            |          |       |
  +----------###############################################----------+-------+
  |          #                ?                            #          |       |
  |          #                |                            #          |       |
  |  hback   #                |                            #  hfront  | hsync |
  |   porch  #                |       hactive              #  porch   |  len  |
  |<-------->#<---------------+--------------------------->#<-------->|<----->|
  |          #                |                            #          |       |
  |          #                |vactive                     #          |       |
  |          #                |                            #          |       |
  |          #                ?                            #          |       |
  +----------###############################################----------+-------+
  |          |                ?                            |          |       |
  |          |                |vfront_porch                |          |       |
  |          |                ?                            |          |       |
  +----------+---------------------------------------------+----------+-------+
  |          |                ?                            |          |       |
  |          |                |vsync_len                   |          |       |
  |          |                ?                            |          |       |
  +----------+---------------------------------------------+----------+-------+


Example:

	display-timings {
		native-mode = <&timing0>;
		timing0: 1920p24 {
			/* 1920x1080p24 */
			clock = <52000000>;
			hactive = <1920>;
			vactive = <1080>;
			hfront-porch = <25>;
			hback-porch = <25>;
			hsync-len = <25>;
			vback-porch = <2>;
			vfront-porch = <2>;
			vsync-len = <2>;
			hsync-active = <1>;
		};
	};

Every required property also supports the use of ranges, so the commonly used
datasheet description with <min typ max>-tuples can be used.

Example:

	timing1: timing {
		/* 1920x1080p24 */
		clock = <148500000>;
		hactive = <1920>;
		vactive = <1080>;
		hsync-len = <0 44 60>;
		hfront-porch = <80 88 95>;
		hback-porch = <100 148 160>;
		vfront-porch = <0 4 6>;
		vback-porch = <0 36 50>;
		vsync-len = <0 5 6>;
	};


Usage in backend
================

A backend driver may choose to use the display-timings directly and convert the timing
ranges to a suitable mode. Or it may just use the conversion of the display timings
to the required mode via the generic videomode struct.

					dtb
					 |
					 |  of_get_display_timing_list
					 ?
			      struct display_timings
					 |
					 |  videomode_from_timing
					 ?
			    ---  struct videomode ---
			    |			    |
 videomode_to_displaymode   |			    |   videomode_to_fb_videomode
		            ?			    ?
		     drm_display_mode         fb_videomode

The functions of_get_fb_videomode and of_get_display_mode are provided
to conveniently get the respective mode representation from the devicetree.

Conversion to videomode
=======================

As device drivers normally work with some kind of video mode, the timings can be
converted (may be just a simple copying of the typical value) to a generic videomode
structure which then can be converted to the according mode used by the backend.
```

## drivers/gpu/drm/lcdc/Kconfig
```kconfig
config DRM_LCDC
	tristate "DRM Support for TI LCDC Display Controller"
	depends on DRM && OF
	select DRM_KMS_HELPER
	select DRM_KMS_CMA_HELPER
	select DRM_GEM_CMA_HELPER
	select DISPLAY_TIMING
	select OF_DISPLAY_TIMINGS
	help
	  Choose this option if you have an TI SoC with LCDC display
	  controller, for example AM33xx in beagle-bone, DA8xx, or
	  OMAP-L1xx.  This driver replaces the FB_DA8XX fbdev driver.

menu "I2C encoder or helper chips"
	depends on DRM && DRM_KMS_HELPER && I2C

config DRM_I2C_NXP_TDA998X
	tristate "NXP Semiconductors TDA998X HDMI encoder"
	default m if DRM_LCDC
	help
	  Support for NXP Semiconductors TDA998X HDMI encoders.

endmenu
```

## drivers/staging/omaprpc/Kconfig
```kconfig
config RPC_OMAP
	tristate "OMAP Remote Procedure Call driver"
	default y
	depends on RPMSG
	depends on (TI_TILER && ION_OMAP) || DMA_SHARED_BUFFER
	depends on REMOTEPROC
	depends on OMAP_REMOTEPROC
	depends on DRM_OMAP
	---help---
	  An rpmsg driver that exposes the Remote Procedure Call API to
	  user space, in order to allow applications to distribute
	  remote calls to more power-efficient remote processors on OMAP4+ systems.

	  If unsure, say N.
```

## drivers/video/nxp/Kconfig
```kconfig
config NXP_TDA998X_OLD
   tristate "NXP TDA998X HDMI video display driver"
   select REGMAP_I2C
   depends on I2C
   help
     Say Y here if you want to support NXP's TDA998X HDMI driver
     To compile this driver as a module, choose M here.
```

## security/yama/Kconfig
```kconfig
config SECURITY_YAMA
	bool "Yama NAC Support"
	depends on SECURITY
	select SECURITYFS
	select SECURITY_PATH
	default n
	help
	  This selects Yama, the NAKed Access Control system which
	  provides additional global security settings above regular
	  Linux discretionary access controls.  Currently available
	  are symlink, hardlink, and PTRACE scope restrictions.

	  If you are unsure how to answer this question, answer N.
```

## ubuntu/Kconfig
```kconfig
menu "Ubuntu Supplied Third-Party Device Drivers"

#
# NOTE: to allow drivers to be added and removed without causing merge
# collisions you should add new entries in the middle of the six lines
# of ## at the bottom of the list.  Always add three lines of ## above
# your new entry and maintain the six lines below.
#

##
##
##
source "ubuntu/compcache/Kconfig"
##
##
##
source "ubuntu/dm-raid4-5/Kconfig"
##
##
##
source "ubuntu/ndiswrapper/Kconfig"
##
##
##
source "ubuntu/rfkill/Kconfig"
##
##
##
source "ubuntu/fsam7400/Kconfig"
##
##
##
source "ubuntu/omnibook/Kconfig"
##
##
##
source "ubuntu/iscsitarget/Kconfig"
##
##
##
source "ubuntu/rtl8192se/Kconfig"
##
##
##
source "ubuntu/aufs/Kconfig"
##
##
##
##
##
##

endmenu
```

## ubuntu/compcache/Kconfig
```kconfig
menu "Compcache options"

config BLK_DEV_COMPCACHE
	tristate "Compressed RAM based swap device"
	default m
	select LZO_COMPRESS
	select LZO_DECOMPRESS
	depends on BLOCK
	help
	  This creates RAM based block device which acts as swap disk. Pages
	  swapped to this disk are compressed and stored in memory itself.
	  Project Home: http://code.google.com/p/compcache/

config BLK_DEV_COMPCACHE_DEBUG
	default n
	depends on BLK_DEV_COMPCACHE
	bool "Enable debugging"
	help
	  This causes negligible performance loss and size increase.
	  If unsure, say Y.

config BLK_DEV_COMPCACHE_STATS
	default n
	depends on BLK_DEV_COMPCACHE
	bool "Enable statistics"
	help
	  Creates /proc/compcache to export various statistics.
	  This adds about 4K to size with negligible performance loss.
	  If unsure, say Y.
 
endmenu
```

## ubuntu/fsam7400/Kconfig
```kconfig
config FSAM7400
	tristate "SW RF kill switch for Fujitsu Siemens Amilo M 7400"
	depends on CHECK_SIGNATURE
	default m
	---help---
```

## ubuntu/ndiswrapper/Kconfig
```kconfig
config NDISWRAPPER
	tristate "Wrapper for Windows NDIS network drivers"
	depends on NET && X86
	default m
```

## ubuntu/omnibook/Kconfig
```kconfig
config OMNIBOOK
	tristate "Kernel module for HP and Toshiba laptops"
	depends on X86
	default m
	---help---
```

## ubuntu/rfkill/Kconfig
```kconfig
config AVERATEC_5100P
	tristate "Software kill switch for Averatec 5100P"
	depends on X86
	default m

config PACKARDBELL_E5
	tristate "Software kill switch for Packard Bell EasyNote E5"
	depends on X86
	default m
```

## ubuntu/rtl8192se/Kconfig
```kconfig
config RTL8192SE
	tristate "Kernel module for RTL81991/2SE or RTL8171 wireless"
	depends on X86
	default m
	---help---
```
