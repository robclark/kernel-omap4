/*
 * Copyright (C) 2012 Texas Instruments Incorporated - http://www.ti.com/
 *
 * This program is free software; you can redistribute it and/or modify
 * it under the terms of the GNU General Public License version 2 as
 * published by the Free Software Foundation.
 */
/include/ "omap4-panda.dts"

/* Audio routing is differnet between PandaBoard4430 and PandaBoardES */
&sound {
	ti,model = "PandaBoardES";

	/* Audio routing */
	ti,audio-routing =
		"Headset Stereophone", "HSOL",
		"Headset Stereophone", "HSOR",
		"Ext Spk", "HFL",
		"Ext Spk", "HFR",
		"Line Out", "AUXL",
		"Line Out", "AUXR",
		"AFML", "Line In",
		"AFMR", "Line In",
		"Headset Playback", "PDM_DL1",
		"Handsfree Playback", "PDM_DL2",
		"PDM_UL1", "Capture",
		"40122000.mcbsp Playback", "BT_VX_DL",
		"BT_VX_UL", "40122000.mcbsp Capture",
		"40124000.mcbsp Playback", "MM_EXT_DL",
		"MM_EXT_UL", "40124000.mcbsp Capture";
};
