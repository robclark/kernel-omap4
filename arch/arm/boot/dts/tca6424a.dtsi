/*
 * Copyright (C) 2012 Texas Instruments Incorporated - http://www.ti.com/
 *
 * This program is free software; you can redistribute it and/or modify
 * it under the terms of the GNU General Public License version 2 as
 * published by the Free Software Foundation.
 */

/*
 * TCA6462A IO Expander
 */
&tca {
	compatible = "ti,tca6424a";
	gpio-controller;
	#gpio-cells = <2>;

	tca_gpio: gpio {
		compatible = "ti,tca6424a-gpio";
	};
};
